## Kconfig
```kconfig
config PROSPECTOR_ROTATE_DISPLAY_180
    bool "Rotate the display 180 degrees"
    default n
```

## config/west.yml
```yaml
manifest:
  remotes:
    - name: zmkfirmware
      url-base: https://github.com/zmkfirmware
    - name: joshyeram                            # <--- add this
      url-base: https://github.com/joshyeram    # <--- and this
  projects:
    - name: zmk
      remote: joshyeram
      revision: removeUSBpowercheck
      import: app/west.yml
  self:
    path: config
```
